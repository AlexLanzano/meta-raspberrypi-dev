## conf/layer.conf
```bitbake
# We have a conf and classes directory, add to BBPATH
BBPATH .= ":${LAYERDIR}"

# We have recipes-* directories, add to BBFILES
BBFILES += "${LAYERDIR}/recipes-*/*/*.bb ${LAYERDIR}/recipes-*/*/*.bbappend"

BBFILE_COLLECTIONS += "raspberrypi-dev"
BBFILE_PATTERN_raspberrypi-dev = "^${LAYERDIR}/"
BBFILE_PRIORITY_raspberrypi-dev = "1"

# This should only be incremented on significant changes that will
# cause compatibility issues with other layers
LAYERVERSION_raspberrypi-dev = "1"

LAYERDEPENDS_raspberrypi-dev = "core raspberrypi"

LAYERSERIES_COMPAT_raspberrypi-dev = "scarthgap"
```
